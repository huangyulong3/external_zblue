## subsys/bluetooth/Kconfig
```kconfig
# Bluetooth configuration options

# Copyright (c) 2016 Intel Corporation
# Copyright (c) 2021 Nordic Semiconductor ASA
# SPDX-License-Identifier: Apache-2.0

menuconfig BT
	bool "Bluetooth"
	# Some BT threads use co-op priorities to implement critical sections,
	# will need some refactoring to work on SMP systems.
	# depends on !SMP
	select NET_BUF
	help
	  This option enables Bluetooth support.

if BT

config ZBLUE_API_PREFIX_ENABLE
	bool "Enable ZBue API prefix for Bluetooth"
	default y
	help
	  This option enables API prefixing for Bluetooth to avoid symbol
	  conflicts when integrating with other stacks.

config BT_ORIGINAL_API
	bool "Enable Original API"
	default y
	help
		Enable Original API for Bluetooth.

choice BT_STACK_SELECTION
	prompt "Bluetooth Stack Selection"
	default BT_HCI
	help
	  Select the Bluetooth stack to compile.

config BT_HCI
	bool "HCI-based"
	help
	  HCI-based stack with optional host & controller parts and an
	  HCI driver in between.

config BT_CUSTOM
	bool "Custom"
	help
	  Select a custom, non-HCI based stack. If you're not sure what
	  this is, you probably want the HCI-based stack instead.

endchoice

# The Bluetooth subsystem requires the system workqueue to execute at
# a cooperative priority.
# config SYSTEM_WORKQUEUE_PRIORITY
#	range -256 -1

if BT_HCI

config BT_HCI_RAW
	bool "RAW HCI access"
	help
	  This option allows to access Bluetooth controller
	  from the application with the RAW HCI protocol.

config BT_HCI_RAW_H4
	bool "RAW HCI H:4 transport"
	help
	  This option enables HCI RAW access to work over an H:4
	  transport, note that it still need to be selected at runtime.

config BT_HCI_RAW_H4_ENABLE
	bool "RAW HCI H:4 transport enable"
	depends on BT_HCI_RAW_H4
	help
	  This option enables use of H:4 transport for HCI RAW access at
	  build time.

config BT_HCI_RAW_CMD_EXT
	bool "RAW HCI Command Extension"
	help
	  This option enables HCI RAW command extension so the driver can
	  register it own command table extension.

config BT_PERIPHERAL
	bool "Peripheral Role support"
	select BT_BROADCASTER
	select BT_CONN
	default y if BT_HCI_RAW
	help
	  Select this for LE Peripheral role support.

config BT_CENTRAL
	bool "Central Role support"
	select BT_OBSERVER
	select BT_CONN
	default y if BT_HCI_RAW
	help
	  Select this for LE Central role support.

config BT_BROADCASTER
	bool "Broadcaster Role support"
	default y if !BT_OBSERVER
	help
	  Select this for LE Broadcaster role support.

config BT_OBSERVER
	bool "Observer Role support"
	help
	  Select this for LE Observer role support.

source "$APPSDIR/external/zblue/zblue/subsys/bluetooth/Kconfig.adv"

config BT_NUM_CTLRS
	int "Number of Bluetooth controllers"
	range 1 8
	default 1
	help
	  Number of Bluetooth controllers supported.

config BT_CONN
	bool

config BT_MAX_CONN
	int "Maximum number of simultaneous connections"
	depends on BT_CONN
	range 1 250
	default 2 if BT_MESH_GATT_CLIENT
	default 1
	help
	  Maximum number of simultaneous Bluetooth connections
	  supported.

config BT_CONN_TX
	bool
	default BT_CONN || BT_ISO_TX
	help
	  Hidden configuration that is true if ACL or broadcast ISO is enabled

if BT_CONN
config BT_HCI_ACL_FLOW_CONTROL
	bool "Controller to Host ACL flow control support"
	# Enable if building a Host-only build
	default y if !BT_CTLR && !BT_STM32_IPM && !BT_ESP32  && !BT_STM32WBA
	# Enable if building a Controller-only build
	default y if BT_HCI_RAW
	select POLL
	help
	  Enable support for throttling ACL buffers from the controller
	  to the host. This is particularly useful when the host and
	  controller are on separate cores since it ensures that we do
	  not run out of incoming ACL buffers.

config BT_REMOTE_VERSION
	bool "Allow fetching of remote version"
	# Enable if building a Controller-only build
	default y if BT_HCI_RAW
	help
	  Enable this to get access to the remote version in the Controller and
	  in the Host through bt_conn_get_remote_info(). The fields in question
	  can then be found in the bt_conn_remote_info struct.

config BT_PHY_UPDATE
	bool "PHY Update"
	default y
	depends on !BT_CTLR || BT_CTLR_PHY_UPDATE_SUPPORT
	help
	  Enable support for Bluetooth 5.0 PHY Update Procedure.

config BT_DATA_LEN_UPDATE
	bool "Data Length Update"
	default y if ((BT_BUF_ACL_TX_SIZE > 27) || (BT_BUF_ACL_RX_SIZE > 27))
	depends on !BT_CTLR || BT_CTLR_DATA_LEN_UPDATE_SUPPORT
	help
	  Enable support for Bluetooth v4.2 LE Data Length Update procedure.

config BT_PER_ADV_SYNC_TRANSFER_RECEIVER
	bool "Periodic Advertising Sync Transfer receiver"
	depends on BT_PER_ADV_SYNC && BT_CONN && (!BT_CTLR || BT_CTLR_SYNC_TRANSFER_RECEIVER_SUPPORT)

config BT_PER_ADV_SYNC_TRANSFER_SENDER
	bool "Periodic Advertising Sync Transfer sender"
	depends on (BT_PER_ADV_SYNC || BT_PER_ADV) && BT_CONN && (!BT_CTLR || BT_CTLR_SYNC_TRANSFER_SENDER_SUPPORT)

config BT_SCA_UPDATE
	bool "Sleep Clock Accuracy Update"
	default y if BT_ISO_PERIPHERAL || BT_ISO_CENTRAL
	depends on !BT_CTLR || BT_CTLR_SCA_UPDATE_SUPPORT
	help
	  Enable support for Bluetooth 5.1 Sleep Clock Accuracy Update Procedure

config BT_TRANSMIT_POWER_CONTROL
	bool "LE Power Control"
	depends on !BT_CTLR || BT_CTLR_LE_POWER_CONTROL_SUPPORT
	help
	  Enable support for LE Power Control Request feature that is defined in the
	  Bluetooth Core specification, Version 5.4 | Vol 6, Part B, Section 4.6.31.

config BT_PATH_LOSS_MONITORING
	bool "LE Path Loss Monitoring"
	depends on !BT_CTLR || BT_CTLR_LE_PATH_LOSS_MONITORING_SUPPORT
	help
	  Enable support for LE Path Loss Monitoring feature that is defined in the
	  Bluetooth Core specification, Version 5.4 | Vol 6, Part B, Section 4.6.32.

config BT_SUBRATING
	bool "LE Connection Subrating [EXPERIMENTAL]"
	select EXPERIMENTAL
	depends on !BT_CTLR || BT_CTLR_SUBRATING_SUPPORT
	help
	  Enable support for LE Connection Subrating feature that is defined in the
	  Bluetooth Core specification, Version 5.4 | Vol 6, Part B, Section 4.6.35.

config BT_CHANNEL_SOUNDING
	bool "Channel Sounding [EXPERIMENTAL]"
	select EXPERIMENTAL
	depends on !BT_CTLR || BT_CTLR_CHANNEL_SOUNDING_SUPPORT
	help
	  Enable support for Bluetooth 6.0 Channel Sounding feature.

config BT_CHANNEL_SOUNDING_TEST
	bool "Channel Sounding Test [EXPERIMENTAL]"
	select EXPERIMENTAL
	depends on BT_CHANNEL_SOUNDING
	help
	  Enable support for Channel Sounding test mode.

config BT_CHANNEL_SOUNDING_REASSEMBLY_BUFFER_SIZE
	int "Subevent result reassembly buffer size"
	depends on BT_CHANNEL_SOUNDING
	range 239 5600
	default 5600
	help
	  When the results for a CS subevent cannot fit into a single HCI event,
	  it will be split up into multiple events and consequently, reassembled into a
	  full CS subevent. This config sets the size of the reassembly buffer.

config BT_CHANNEL_SOUNDING_REASSEMBLY_BUFFER_CNT
	int "Subevent result reassembly buffer count"
	depends on BT_CHANNEL_SOUNDING
	range 1 BT_MAX_CONN
	default 1
	help
	  Controls the number of the reassembly buffers for CS subevent
	  results. Each running CS procedure is allocated one buffer and the
	  number of concurrent CS procedures is limited by this value.

endif # BT_CONN

source "$APPSDIR/external/zblue/zblue/subsys/bluetooth/Kconfig.iso"
source "$APPSDIR/external/zblue/zblue/subsys/bluetooth/common/Kconfig"
source "$APPSDIR/external/zblue/zblue/subsys/bluetooth/host/Kconfig"
# source "$APPSDIR/external/zblue/zblue/subsys/bluetooth/controller/Kconfig"

# Simplified BT_CTLR config for NuttX (controller code compiled via Makefile)
config BT_CTLR
	bool "Bluetooth Controller"
	help
	  Enables support for SoC native controller implementations.
	  Controller source files are added via Makefile.default.

config BT_CTLR_VIRTUAL_RADIO
	bool "Virtual Radio (Socket-based simulation)"
	default y if BT_CTLR
	help
	  Enable socket-based virtual radio for BLE controller simulation
	  in QEMU. This replaces hardware radio with UDP socket communication
	  for transmitting and receiving BLE PDUs. The radio ISR, RTC timer,
	  and software interrupts are simulated using NuttX work queues and
	  POSIX timers.

config BT_CTLR_HCI
	bool "HCI interface for controller"
	default y if BT_CTLR
	help
	  Enable HCI interface for the Bluetooth controller.
	  This compiles hci.c and hci_driver.c.

config BT_CTLR_ADV_EXT_SUPPORT
	bool
	default y if BT_CTLR
	help
	  Selected by the controller to indicate support for Extended Advertising.

config BT_CTLR_SCAN_REQ_NOTIFY_SUPPORT
	bool
	default y if BT_CTLR

config BT_CTLR_DATA_LEN_UPDATE_SUPPORT
	bool
	default y if BT_CTLR

config BT_CTLR_PHY_UPDATE_SUPPORT
	bool
	default y if BT_CTLR

config BT_CTLR_CHAN_SEL_2_SUPPORT
	bool
	default y if BT_CTLR

config BT_CTLR_COMPANY_ID
	hex "Company ID"
	default 0x038F
	help
	  Set the Bluetooth Company Identifier that will be used in
	  the VERSION_IND PDU. Uses Nordic Semiconductor ASA by default.

config BT_CTLR_SUBVERSION_NUMBER
	hex "Subversion Number"
	default 0xFFFF
	help
	  Set the Subversion Number that will be used in VERSION_IND PDU.

config BT_CTLR_RX_BUFFERS
	int "Number of Rx buffers"
	default 6
	help
	  Set the number of Rx PDU buffers.

config BT_CTLR_LLCP_CONN
	int "Number of LLCP connections"
	default BT_MAX_CONN
	help
	  Set the number of LLCP connections.

config BT_CTLR_LLCP_TX_PER_CONN_TX_CTRL_BUF_NUM_MAX
	int "Max TX control buffers per connection"
	default 1
	help
	  Set the max number of TX control buffers per connection.

config BT_CTLR_LLCP_COMMON_TX_CTRL_BUF_NUM
	int "Common TX control buffers"
	default 4
	help
	  Set the number of common TX control buffers.

config BT_CTLR_LLCP_PER_CONN_TX_CTRL_BUF_NUM
	int "Per connection TX control buffers"
	default 1
	help
	  Set the number of per connection TX control buffers.

config BT_CTLR_LLCP_LOCAL_PROC_CTX_BUF_NUM
	int "Number of local control procedure contexts"
	default 6 if BT_CTLR_LLCP_CONN < 4
	default 2 if BT_CTLR_LLCP_CONN = 1
	default BT_CTLR_LLCP_CONN
	help
	  Set the number of local control procedure contexts available.
	  This defines the size of the pool of control procedure contexts
	  for handling local initiated control procedures.

config BT_CTLR_LLCP_REMOTE_PROC_CTX_BUF_NUM
	int "Number of remote control procedure contexts"
	default BT_CTLR_LLCP_CONN
	help
	  Set the number of remote control procedure contexts available.
	  This defines the size of the pool of control procedure contexts
	  for handling remote initiated control procedures.

config BT_CTLR_LLL_PRIO
	int "Lower Link Layer (Radio) IRQ priority"
	default 0
	help
	  The interrupt priority for event preparation and radio IRQ.

config BT_CTLR_ULL_HIGH_PRIO
	int "Upper Link Layer High IRQ priority"
	default 1
	help
	  The interrupt priority for Ticker's Worker IRQ and Upper Link Layer
	  higher priority functions.

config BT_CTLR_ULL_LOW_PRIO
	int "Upper Link Layer Low IRQ priority"
	default 1
	help
	  The interrupt priority for Ticker's Job IRQ and Upper Link Layer
	  lower priority functions.

config BT_CTLR_EVENT_IFS_LOW_LAT_US
	int "Low latency tIFS value in microseconds"
	default 150
	help
	  Set low latency tIFS value.

config BT_CTLR_FILTER_ACCEPT_LIST
	bool "Filter Accept List Support"
	default y
	help
	  Enable support for controller Filter Accept List feature

config BT_CTLR_FAL_SIZE
	int "Filter Accept List size"
	depends on BT_CTLR_FILTER_ACCEPT_LIST
	default 8
	help
	  Set the size of the Filter Accept List.

config BT_CTLR_BREDR
	bool "BR/EDR Controller Support"
	depends on BT_CTLR
	help
	  Enable support for BR/EDR Controller in the Bluetooth stack.
	  This implements the BR/EDR Controller as defined in
	  Bluetooth Core Specification Vol 2.

config BT_CTLR_BREDR_TX_BUFFERS
	int "BR/EDR TX buffers"
	default 4
	depends on BT_CTLR_BREDR
	help
	  Number of TX buffers for BR/EDR controller.

source "$APPSDIR/external/zblue/zblue/subsys/bluetooth/crypto/Kconfig"
source "$APPSDIR/external/zblue/zblue/subsys/bluetooth/lib/Kconfig"
# source "$APPSDIR/external/zblue/zblue/subsys/bluetooth/Kconfig.logging"

config BT_SHELL
	bool "Bluetooth shell"
	select SHELL
	select BT_TICKER_NEXT_SLOT_GET if BT_LL_SW_SPLIT
	help
	  Activate shell module that provides Bluetooth commands to the
	  console.

endif # BT_HCI

config BT_COMPANY_ID
	hex "Company Id"
	default 0x038F
	range 0x0000 0xFFFF
	help
	  Set the Bluetooth Company Identifier for this device. The Xiaoni
	  Company Identifier (0x05F1) is the default value for
	  this option although Xiaomi vendors and hardware manufacturers
	  can set their own. Note that the controller's Company Identifier is
	  controlled by BT_CTLR_COMPANY_ID. The full list of Bluetooth
	  Company Identifiers can be found here:
	  https://www.bluetooth.com/specifications/assigned-numbers/company-identifiers

endif # BT
```
