## subsys/bluetooth/controller/ll_sw/bredr/Kconfig
```kconfig
# /****************************************************************************
#  *  Copyright (C) 2026 Xiaomi Corporation
#  *
#  * Licensed under the Apache License, Version 2.0 (the "License");
#  * you may not use this file except in compliance with the License.
#  * You may obtain a copy of the License at
#  *
#  *      http://www.apache.org/licenses/LICENSE-2.0
#  *
#  * Unless required by applicable law or agreed to in writing, software
#  * distributed under the License is distributed on an "AS IS" BASIS,
#  * WITHOUT WARRANTIES OR CONDITIONS OF ANY KIND, either express or implied.
#  * See the License for the specific language governing permissions and
#  * limitations under the License.
#  ***************************************************************************/

# BR/EDR Controller configuration options

config BT_CTLR_BREDR
	bool "BR/EDR Controller Support"
	depends on BT_CTLR
	help
	  Enable support for BR/EDR Controller in the Bluetooth stack.
	  This implements the BR/EDR Controller as defined in
	  Bluetooth Core Specification Vol 2.

if BT_CTLR_BREDR

config BT_CTLR_BREDR_MAX_CONN
	int "Maximum number of BR/EDR connections"
	default 4
	range 1 7
	help
	  Maximum number of simultaneous BR/EDR ACL connections.

config BT_CTLR_BREDR_SCO_MAX
	int "Maximum number of SCO connections"
	default 2
	range 0 3
	help
	  Maximum number of simultaneous SCO connections.

config BT_CTLR_BREDR_ESCO_MAX
	int "Maximum number of eSCO connections"
	default 2
	range 0 3
	help
	  Maximum number of simultaneous eSCO connections.

config BT_CTLR_BREDR_INQUIRY
	bool "BR/EDR Inquiry Support"
	default y
	help
	  Enable support for BR/EDR Inquiry procedure.

config BT_CTLR_BREDR_PAGE
	bool "BR/EDR Paging Support"
	default y
	help
	  Enable support for BR/EDR Paging procedure.

config BT_CTLR_BREDR_PAGE_SCAN
	bool "BR/EDR Page Scan Support"
	default y
	help
	  Enable support for BR/EDR Page Scan procedure.

config BT_CTLR_BREDR_INQUIRY_SCAN
	bool "BR/EDR Inquiry Scan Support"
	default y
	help
	  Enable support for BR/EDR Inquiry Scan procedure.

config BT_CTLR_BREDR_EIR
	bool "BR/EDR Extended Inquiry Response"
	default y
	help
	  Enable support for Extended Inquiry Response.

config BT_CTLR_BREDR_SSP
	bool "BR/EDR Secure Simple Pairing"
	default y
	help
	  Enable support for Secure Simple Pairing.

config BT_CTLR_BREDR_EDR
	bool "BR/EDR Enhanced Data Rate"
	default y
	help
	  Enable support for Enhanced Data Rate (2 Mbps and 3 Mbps).

config BT_CTLR_BREDR_AFH
	bool "BR/EDR Adaptive Frequency Hopping"
	default y
	help
	  Enable support for Adaptive Frequency Hopping.

config BT_CTLR_BREDR_SNIFF
	bool "BR/EDR Sniff Mode"
	default y
	help
	  Enable support for Sniff mode power saving.

config BT_CTLR_BREDR_HOLD
	bool "BR/EDR Hold Mode"
	default n
	help
	  Enable support for Hold mode.

config BT_CTLR_BREDR_PARK
	bool "BR/EDR Park Mode"
	default n
	help
	  Enable support for Park mode.

config BT_CTLR_BREDR_ROLE_SWITCH
	bool "BR/EDR Role Switch"
	default y
	help
	  Enable support for Central/Peripheral role switch.

config BT_CTLR_BREDR_TX_BUFFERS
	int "Number of BR/EDR TX buffers"
	default 4
	range 1 16
	help
	  Number of TX buffers for BR/EDR ACL data.

config BT_CTLR_BREDR_RX_BUFFERS
	int "Number of BR/EDR RX buffers"
	default 4
	range 1 16
	help
	  Number of RX buffers for BR/EDR ACL data.

endif # BT_CTLR_BREDR
```

## tests/bluetooth/tester/Kconfig
```kconfig
# Config options for tester app

# Copyright (c) 2023 Codecoup
# SPDX-License-Identifier: Apache-2.0

menu "Bttester configuration"

module = BTTESTER
module-str = bttester
source "subsys/logging/Kconfig.template.log_config"

config Z_API_USE_FRAMEWORK
	bool "Use Framework Bluetooth API for z_api"
	default n
	help
	  When enabled, z_api() functions will be implemented using
	  the Framework Bluetooth API (z_port layer).
	  When disabled, z_api() functions will directly call the
	  original Zephyr Bluetooth API (for Zblue environment).

	  Enable this option when running bttester with the OpenVela
	  Framework Bluetooth stack instead of Zblue.

endmenu

source "Kconfig.zephyr"
```
